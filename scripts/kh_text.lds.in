/* KernelHook: isolate library code into page-aligned section.
 * Generated by CMake — do not edit directly.
 * Page alignment: @KH_PAGE_ALIGN@ bytes */
SECTIONS {
    .text.kh ALIGN(@KH_PAGE_ALIGN@) : {
        __kh_text_start = .;
        /* Match library .o members inside the static archive.
         * lld requires archive:member syntax for .a members.
         * transit.c.o is excluded — any explicit capture of its sections
         * (even .text only) causes lld to miscompile the binary. Its
         * .text.transit_body and .text.fp_transit_body become orphan
         * sections placed adjacent to .text.kh by lld's orphan placement,
         * which is acceptable since they are never executed in-place
         * (copied to ROX pages at runtime). */
        *libkernelhook.a:hook.c.o(.text .text.*)
        *libkernelhook.a:hmem.c.o(.text .text.*)
        *libkernelhook.a:inline.c.o(.text .text.*)
        *libkernelhook.a:insn.c.o(.text .text.*)
        *libkernelhook.a:linux.c.o(.text .text.*)
        *libkernelhook.a:darwin.c.o(.text .text.*)
        *libkernelhook.a:hmem_user.c.o(.text .text.*)
        *libkernelhook.a:hook_install.c.o(.text .text.*)
        *libkernelhook.a:log.c.o(.text .text.*)
        *libkernelhook.a:remote_linux.c.o(.text .text.*)
        *libkernelhook.a:remote_stub.c.o(.text .text.*)
        *libkernelhook.a:section_fence.c.o(.text .text.*)
        . = ALIGN(@KH_PAGE_ALIGN@);
        __kh_text_end = .;
    }
}
INSERT AFTER .text;
